## drivers/input/touchscreen/ft5626/Kconfig
```kconfig
#
# Focaltech 5626 touchscreen driver configuration
#
menuconfig TOUCHSCREEN_FT_5626
	bool "Focaltech 5626"
	default y
	help
	  Say Y here if you have a Synaptics DSX touchscreen connected
	  to your system.

	  If unsure, say N.

if TOUCHSCREEN_FT_5626

config TOUCHSCREEN_FTS
       tristate "FocalTech touchscreens"
       depends on I2C
       help
         Say Y here if you have a ft8716 touchscreen.
	 Ft5x06 controllers are multi touch controllers which can
	 report 5 touches at a time.

         If unsure, say N.

         To compile this driver as a module, choose M here: the module will be called fts_ts.

endif
```
